/ {
    keyboard {
        keymap {
            compatible = "zmk,keymap";
            default_layer {
                bindings = <
                    &kp A
                >;
            };
        };
    };
};
