## config/boards/shields/stryke/Kconfig.defconfig
```kconfig
if SHIELD_STRYKE

config ZMK_DISPLAY
	default y

if LVGL

config LV_Z_VDB_SIZE
	int
	default 64

config LV_Z_DPI
	int
	default 148

config LV_Z_BITS_PER_PIXEL
	int
	default 1

config LV_USE_CANVAS
	bool
	default y

endif # LVGL

endif # SHIELD_STRYKE
```

## config/boards/shields/stryke/Kconfig.shield
```kconfig
config SHIELD_STRYKE
    def_bool $(shields_list_contains,stryke)
    select ZMK_DISPLAY
```

## config/west.yml
```yaml
manifest:
  remotes:
    - name: zmkfirmware
      url-base: https://github.com/zmkfirmware
  projects:
    - name: zmk
      remote: zmkfirmware
      revision: 354cff9c36b49eee6abbb8a61e6b927539aebbf2
      import: app/west.yml
  self:
    path: config
```

## zmk-stryke/west.yml
```yaml
manifest:
  defaults:
    revision: v0.3
  remotes:
    - name: zmkfirmware
      url-base: https://github.com/zmkfirmware
  projects:
    - name: zmk
      remote: zmkfirmware
      import: app/west.yml
    - name: zmk-stryke
      remote: zmkfirmware
      revision: main
      path: zmk-stryke  # <--- Changed this from 'config' to 'zmk-stryke'
  self:
    path: config
```
